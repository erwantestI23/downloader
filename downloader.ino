#include "M5Cardputer.h"
#include "M5GFX.h"
#include <WiFi.h>
#include <HTTPClient.h>
#include <SD.h>
#include <FS.h>
#include <Adafruit_NeoPixel.h>
const uint16_t epd_bitmap_logo [] PROGMEM = {
  0xffff, 0xffff, 0xffff, 0xffff, 0xffff, 0xffff, 0xffff, 0xffff, 0xffff, 0xffff, 0xffff, 0xffff, 0xffff, 0xffff, 0xffff, 0xffff, 
  0xffff, 0xffff, 0xffff, 0xffff, 0xffff, 0xffff, 0xffff, 0xffff, 0xffff, 0xffff, 0xffff, 0xffff, 0xffff, 0xffff, 0xffff, 0xffff, 
  0xffff, 0xffff, 0xffff, 0xffff, 0xffff, 0xffff, 0xffff, 0xffff, 0xffff, 0xffff, 0xffff, 0xffff, 0xffff, 0xffff, 0xffff, 0xffff, 
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  0xffff, 0xffff, 0xffff, 0xffff, 0xffff, 0xffff, 0xffff, 0xffff
};
#define PIN_RGB_LED 21 
Adafruit_NeoPixel pixel(1, PIN_RGB_LED, NEO_GRB + NEO_KHZ800);
String wifi, password, url;
int level = 0;
M5Canvas canvas(&M5Cardputer.Display);
String data = "";
#include "sdusb.h"
#define SD_MISO  39
#define SD_MOSI  14
#define SD_SCK   40
#define SD_CS    12
SDCard2USB dev;
void displayError(const char* message) {
  canvas.pushSprite(4, 4);
  setPixelColor(255, 0, 0); 
  canvas.fillScreen(BLACK);
  canvas.println(message);
  delay(2000);
  level = 3; 
  showLevelMessage();
}
void setup() {
  auto cfg = M5.config();
  M5Cardputer.begin(cfg, true);
  if(dev.initSD(SD_SCK, SD_MISO, SD_MOSI, SD_CS))
  {
    if(dev.begin()) {
    } else log_e("LUN 1 failed");
  } else {
    
  }
  M5Cardputer.Display.setRotation(1);
  M5Cardputer.Display.setTextSize(0.5);
  M5Cardputer.Display.setTextFont(&fonts::FreeSerifBoldItalic18pt7b);
    M5.Lcd.fillScreen(WHITE);

  M5.Lcd.drawBitmap(0, 0, 60, 70, epd_bitmap_logo);
  delay(3000);
  M5.Lcd.fillScreen(BLACK);
  canvas.setTextFont(&fonts::FreeSerifBoldItalic18pt7b);
  canvas.setTextSize(0.5);
  canvas.createSprite(M5Cardputer.Display.width() - 8, M5Cardputer.Display.height() - 36);
  canvas.setTextScroll(true);
  pixel.begin(); // Initialiser le NeoPixel
  pixel.setBrightness(255); // Ajuster la luminosité
  pixel.show(); // Mettre à jour la LED
  //if (!SD.begin()) {
   // displayError("SD Card Mount Failed");
    //return;
 // }
  showLevelMessage();
}
void loop() {
  M5Cardputer.update();
  if (M5Cardputer.Keyboard.isChange()) {
    if (M5Cardputer.Keyboard.isPressed()) {
      Keyboard_Class::KeysState status = M5Cardputer.Keyboard.keysState();
      for (auto i : status.word) {
        data += i;
      }
      if (status.del) {
        data.remove(data.length() - 1);
      }
      if (status.enter) {
        if (level == 0) {
          wifi = data;
          level = 1;
        } else if (level == 1) {
          password = data;
          level = 2;
        } else if (level == 2) {
          connectWiFi();
        } else if (level == 3) {
          url = data;
          downloadFile(url);
        }
        data = ""; // Réinitialiser l'entrée pour la prochaine étape
        showLevelMessage();  // Mettre à jour le message de niveau
      }
      M5Cardputer.Display.fillRect(0, M5Cardputer.Display.height() - 28, M5Cardputer.Display.width(), 25, BLACK);
      M5Cardputer.Display.drawString(data, 4, M5Cardputer.Display.height() - 24);
    }
  }
}
void connectWiFi() {
  WiFi.begin(wifi.c_str(), password.c_str());
  setPixelColor(255, 255, 0); // Jaune pour la connexion Wi-Fi
  int attempts = 0;
  while (WiFi.status() != WL_CONNECTED) {
    if (attempts == 25) {
      ESP.restart();
    }
    delay(500);
    attempts++;
  }
  level = 3; 
  setPixelColor(0, 255, 0);
  showLevelMessage();
}

void downloadFile(String fileURL) {
  if (WiFi.status() == WL_CONNECTED) {
    HTTPClient http;
    http.begin(fileURL);
    int httpCode = http.GET();

    if (httpCode == HTTP_CODE_OK) {
      String fileName = "/" + fileURL.substring(fileURL.lastIndexOf('/') + 1);
      File file = SD.open(fileName, FILE_WRITE);

      if (file) {
        WiFiClient* stream = http.getStreamPtr();
        uint8_t buffer[1024]; // Augmenter la taille du tampon
        int totalBytes = http.getSize();
        int downloadedBytes = 0;

        setPixelColor(0, 0, 255); // Bleu pour téléchargement en cours

        while (http.connected() && (stream->available() > 0 || downloadedBytes < totalBytes)) {
          int len = stream->readBytes(buffer, sizeof(buffer));
          if (file.write(buffer, len) != len) {
            displayError("SD Write Error");
            break;
          }
          downloadedBytes += len;

          // Affichage de l'avancement du téléchargement (gérer -1 pour totalBytes)
          if (totalBytes > 0) {
            canvas.fillScreen(BLACK);
            canvas.printf("Downloading %d%%", (downloadedBytes * 100) / totalBytes);
            canvas.pushSprite(4, 4);
          }
        }

        file.flush(); // S'assurer que tout est écrit sur la carte SD
        file.close();

        setPixelColor(0, 255, 0); // Vert pour succès
        canvas.fillScreen(BLACK);
        canvas.println("Downloaded!");
        canvas.pushSprite(4, 4);
        delay(2000);

        level = 3; // Revenir à la saisie de l'URL
        showLevelMessage();
      } else {
        displayError("SD Open Error");
      }
    } else {
      displayError("HTTP Error");
    }

    http.end();
  } else {
    displayError("WiFi Disconnected");
  }
}


void showLevelMessage() {
  canvas.fillScreen(BLACK);
  
  switch (level) {
    case 0:
              canvas.pushSprite(4, 4);

      canvas.println("Wi-Fi:");
      setPixelColor(255, 255, 0); // Jaune pour saisie de SSID
      break;
    case 1:
              canvas.pushSprite(4, 4);

      canvas.println("Password:");
      setPixelColor(255, 255, 0); // Jaune pour saisie de mot de passe
      break;
    case 2:
              canvas.pushSprite(4, 4);

      canvas.println("Connecting");
      setPixelColor(255, 255, 0); // Jaune pour connexion Wi-Fi
      break;
    case 3:
              canvas.pushSprite(4, 4);

      canvas.println("Url:");
      setPixelColor(255, 255, 0); // Jaune pour saisie de l'URL
      break;
    case 4:
              canvas.pushSprite(4, 4);

      canvas.println("Downloading...");
      setPixelColor(0, 0, 255); // Bleu pour téléchargement en cours
      break;
    default:
              canvas.pushSprite(4, 4);

      canvas.println("Finished");
      setPixelColor(0, 255, 0); // Vert pour succès final
      break;
  }
  
  canvas.pushSprite(4, 4);
}

void setPixelColor(uint8_t r, uint8_t g, uint8_t b) {
  pixel.setPixelColor(0, pixel.Color(r, g, b));
  pixel.show();
}
